## CMakeLists.txt
```
cmake_minimum_required(VERSION 3.20.0)
set(ZEPHYR_BASE /home/sensible/actions-runner/_work/SEN-GS-1-TM-Firmware-CGM-Zephyr/zephyr) 

# Find the Zephyr package
find_package(Zephyr REQUIRED HINTS ${ZEPHYR_BASE})

project(app)

set(SOURCES
    src/main.cpp
)

# Include test directories
target_sources(app PRIVATE ${SOURCES})
```

## prj.conf
```kconfig
### Bluetooth options ###
CONFIG_BT=y
CONFIG_BT_PERIPHERAL=y
CONFIG_BT_DEVICE_NAME="SEN-GS-1-INTEGRATION-DUT"
CONFIG_BT_DEVICE_NAME_DYNAMIC=y

# Bluetooth Security
CONFIG_BT_SMP=y
CONFIG_BT_SMP_ENFORCE_MITM=y
CONFIG_BT_FIXED_PASSKEY=y

# Bluetooth Controller
CONFIG_BT_MAX_CONN=1
CONFIG_BT_MAX_PAIRED=2
CONFIG_BT_KEYS_OVERWRITE_OLDEST=y

# Needed for MTU Exchange, could be removed when not sending raw data anymore
CONFIG_BT_GATT_CLIENT=y

# Dependencies for UICR
CONFIG_SOC_FLASH_NRF_UICR=y
CONFIG_NRF_REGTOOL_GENERATE_UICR=y
CONFIG_PINCTRL=y
CONFIG_SOC_SERIES_NRF52X=y

# Enable C++ support
CONFIG_CPP=y
CONFIG_STD_CPP17=y
CONFIG_REQUIRES_FULL_LIBCPP=y
CONFIG_LOG=y

# Bluetooth storage
CONFIG_FLASH=y
CONFIG_FLASH_PAGE_LAYOUT=y
CONFIG_FLASH_MAP=y
CONFIG_NVS=y
CONFIG_SETTINGS=y
CONFIG_SETTINGS_NVS_SECTOR_COUNT=2
CONFIG_BT_SETTINGS=y

# Sensible modules
CONFIG_SENS_COMM=y
CONFIG_SENS_UTILS=y
CONFIG_SENS_ERROR_HANDLER=y
CONFIG_RESET_ON_FATAL_ERROR=n
```

## src/main.cpp
```c
#include <zephyr/bluetooth/bluetooth.h>
#include <zephyr/bluetooth/gap.h>
#include <zephyr/logging/log.h>

#include <communication/CommunicationService.h>
#include <utils/SensibleUICR.h>

LOG_MODULE_REGISTER(dut); // Register logging module

namespace
{
    EventDispatcher dispatcher;
    CommunicationService communicationService(dispatcher);
}

int main()
{
    LOG_INF("Starting DUT");
    Uicr::init();
    communicationService.init();

    return 0;
}
```
